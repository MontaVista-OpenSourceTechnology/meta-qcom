## conf/machine/rb3gen2-core-kit-open-fw.conf
```bitbake
#@TYPE: Machine
#@NAME: Qualcomm RB3Gen2 Development Kit (Core Kit with open boot firmware)
#@DESCRIPTION: Machine configuration for Qualcomm RB3Gen2 development Kit, with QCS6490

require conf/machine/rb3gen2-core-kit.conf

EXTRA_IMAGEDEPENDS += "trusted-firmware-a-qcom"

MACHINE_FEATURES += "optee"
MACHINE_EXTRA_RRECOMMENDS += "${@bb.utils.contains('BBFILE_COLLECTIONS', 'meta-arm', 'packagegroup-optee', '', d)}"

UBOOT_CONFIG = "qcs6490-rb3gen2"
```

## conf/machine/sm8750-mtp.conf
```bitbake
#@TYPE: Machine
#@NAME: Qualcomm SM8750 Development Kit
#@DESCRIPTION: Machine configuration for Qualcomm SM8750 development Kit

require conf/machine/include/qcom-sm8750.inc

MACHINE_FEATURES = "efi usbhost usbgadget alsa wifi bluetooth"

QCOM_DTB_DEFAULT ?= "sm8750-mtp"

ABL_SIGNATURE_VERSION ?= "v7"

KERNEL_DEVICETREE ?= " \
                      qcom/sm8750-mtp.dtb \
                      "

MACHINE_ESSENTIAL_EXTRA_RRECOMMENDS += " \
    packagegroup-sm8750-mtp-firmware \
    packagegroup-sm8750-mtp-hexagon-dsp-binaries \
    qcom-fastcv-binaries-sm8750-mtp-dsp \
"
```
